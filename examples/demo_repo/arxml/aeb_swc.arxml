AUTOSAR XML (schema 4.0)
package /ADAS_Components
  application sw component type SWC_AEB
    provide port PpBrakeCommand: provided-interface=/Interfaces/If_BrakeCommand
    require port RpRadarTarget: required-interface=/Interfaces/If_RadarTarget
    behavior IB_SWC_AEB
      runnable Runnable_AEB: symbol=C_Function_CalculateTTC
